## drivers/input/touchscreen/synaptics_dsx/Kconfig
```kconfig
#
# SYNAPTICS TOUCH driver configuration
#
config TOUCHSCREEN_SYNAPTICS_DSX_I2C
	tristate "Synaptics DSX I2C touchscreen"
	depends on I2C
	help
	  Say Y here if you have a Synaptics DSX I2C touchscreen
	  connected to your system.

	  If unsure, say N.

	  To compile this driver as a module, choose M here: the
	  module will be called synaptics_dsx_i2c.
```
